/*
 * 太鼓达人自动演奏上分emmmm
 * 好像外挂啊。。。
 * zpxrainbowdash编写
 * 版本1.0
 */
int buttonPin = 5;   //针脚定义
int Left_red = 1;
int Right_red = 2;
int Left_blue = 3;
int Right_blue = 4;
int buttonState = 0; // 存储按键状态值
void setup() {     //按键声明
  pinMode(buttonPin, INPUT_PULLUP);
  pinMode(Left_red, OUTPUT);
  pinMode(Right_red, OUTPUT);
  pinMode(Left_blue, OUTPUT);
  pinMode(Right_blue, OUTPUT);
}

void loop(){
//输入歌曲信息
  int bpm=154;     //歌曲bpm bpm请勿高于210
  int total=1808;
  char pumian[]={                 //歌曲谱面如果谱面不满的请补0
    
1,0,0,1,0,0,1,0,1,0,0,1,0,0,1,0,
1,0,0,1,0,0,1,0,2,0,0,0,2,0,0,0,
1,0,0,1,0,0,1,0,1,0,0,1,0,0,1,0,
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4,0,0,4,0,0,3,0,3,0,0,0,0,0,0,0

};
/*
 * 之后的数据尽量不要改
 * 
 */
int shaky = 20;                      //抖动修正(按键从按下到抬起的时间)
int bpm_speed = 15000/bpm;           //计算延迟时间
bpm_speed = bpm_speed - shaky;
int hit = bpm_speed/shaky;           //计算黄条在单位时间内能打几次 
int i=0;                             //初始化i的值
int e=0;                             //初始化e的值

//按钮触发

buttonState = digitalRead(buttonPin);
 if (buttonState == LOW) {           // 若按键被按下
     delay(80);                      //等待跳过按键抖动的不稳定过程
     if (buttonState == LOW){        // 若按键被按下 

//运行核心代码

        while (i<=total-1)
        {
            if(pumian[i]=='0'){
              i++;
              delay (bpm_speed+shaky);
            }
            
            else if(pumian[i]=='1'){   //咚
              i++;
              digitalWrite(Left_red,HIGH);
              delay(shaky);
              digitalWrite(Left_red,LOW);
              delay (bpm_speed);
            }
            
            else if(pumian[i]=='2'){   //咔
              i++;
              digitalWrite(Left_blue,HIGH);
              delay(shaky);
              digitalWrite(Left_blue,LOW);
              delay (bpm_speed);
            }
            
            else if(pumian[i]=='3'){   //大咚
              i++;
              digitalWrite(Left_red,HIGH);
              digitalWrite(Right_red,HIGH);
              delay(shaky);
              digitalWrite(Left_red,LOW);
              digitalWrite(Right_red,LOW);
              delay (bpm_speed);
            }
            
            else if(pumian[i]=='4'){   //大咔
              i++;
              digitalWrite(Left_blue,HIGH);
              digitalWrite(Right_blue,HIGH);
              delay(shaky);
              digitalWrite(Left_blue,LOW);
              digitalWrite(Right_blue,LOW);
              delay (bpm_speed);
            }

            else if(pumian[i]=='5'||pumian[i]=='6'||pumian[i]=='7'){  //黄条 大黄条 气球 这里指一个字符的时长
              
              i++;
              while(hit!=e){
                digitalWrite(Left_red,HIGH);
                delay(shaky);
                digitalWrite(Left_red,LOW);
                digitalWrite(Right_red,HIGH);
                delay(shaky);
                digitalWrite(Right_red,LOW);
                e++;
              }
               
              delay(bpm_speed-2*hit*shaky); //2个shaky的hit倍
              e=0;                          //初始化e的值
              
              while(pumian[i]!='8'){
                i++;
                while(hit!=e){              //直到时间不够击打跳出循环
                digitalWrite(Left_red,HIGH);
                delay(shaky);
                digitalWrite(Left_red,LOW);
                digitalWrite(Right_red,HIGH);
                delay(shaky);
                digitalWrite(Right_red,LOW);
                  e++;
                }
                delay(bpm_speed-2*hit*shaky);//2个shaky的hit倍
              }
              
              e=0;                          //初始化e的值
              
              while(hit!=e){                //直到时间不够击打跳出循环
                digitalWrite(Left_red,HIGH);
                delay(shaky);
                digitalWrite(Left_red,LOW);
                digitalWrite(Right_red,HIGH);
                delay(shaky);
                digitalWrite(Right_red,LOW);
                e++;
              }
              
              delay(bpm_speed-2*hit*shaky);//2个shaky的hit倍
              e=0;                         //初始化e的值
            }
            else {
            i++;
            delay (bpm_speed+shaky);
            }
        }
     }
 }
}
